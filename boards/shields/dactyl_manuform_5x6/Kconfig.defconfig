## boards/shields/dactyl_manuform_5x6/Kconfig.defconfig
```kconfig
if SHIELD_GRACTYL_MANUFORM_LEFT

    config ZMK_KEYBOARD_NAME
        default "GRACTYL(Left)"

    config ZMK_SPLIT_BLE_ROLE_CENTRAL
        default y

endif

if SHIELD_GRACTYL_MANUFORM_RIGHT

    config ZMK_KEYBOARD_NAME
        default "GRACTYL(Right)"

endif

if SHIELD_GRACTYL_MANUFORM_LEFT || SHIELD_GRACTYL_MANUFORM_RIGHT

    config ZMK_SPLIT
        default y

endif
```

## boards/shields/dactyl_manuform_5x6/Kconfig.shield
```kconfig
config SHIELD_GRACTYL_MANUFORM_LEFT
    def_bool $(shields_list_contains,gractyl_manuform_left)

config SHIELD_GRACTYL_MANUFORM_RIGHT
    def_bool $(shields_list_contains,gractyl_manuform_right)
```

## boards/shields/gractyl/Kconfig.shield
```kconfig
config SHEILD_GRACTYL_LEFT
        def_bool $(sheild_list_contains,gractyl_left)

config SHEILD_GRACTYL_LEFT
        def_bool $(sheild_list_contains,gractyl_right)
```
